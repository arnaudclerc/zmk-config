## config/west.yml
```yaml
manifest:
  remotes:
    - name: zmkfirmware
      url-base: https://github.com/zmkfirmware
    - name: mike1808
      url-base: https://github.com/mike1808
  projects:
    - name: zmk
      remote: zmkfirmware
      revision: main
      import: app/west.yml
    - name: nice-view-gem
      remote: mike1808
      revision: feat/mods
    - name: prospector-zmk-module
      remote: mike1808
      revision: fix/new-status-screan-zmk-refactor
  self:
    path: config
```
